## ESP32-P4-WIFI6-Touch-LCD-4.3/examples/esp-idf/01_HowToCreateProject/sdkconfig.defaults
```kconfig
CONFIG_IDF_TARGET="esp32p4"
CONFIG_ESP32P4_REV_MIN_300=y
CONFIG_BOOTLOADER_LOG_LEVEL_WARN=y
CONFIG_BOOTLOADER_LOG_LEVEL=2
CONFIG_ESPTOOLPY_FLASHSIZE_32MB=y
CONFIG_SPIRAM=y
CONFIG_SPIRAM_SPEED_250M=y
```

## ESP32-P4-WIFI6-Touch-LCD-4.3/examples/esp-idf/06_I2SCodec/main/Kconfig.projbuild
```kconfig
menu "Example Configuration"

    choice EXAMPLE_MODE
        prompt "Example mode"
        default EXAMPLE_MODE_MUSIC
        help
            Select example work mode

        config EXAMPLE_MODE_MUSIC
            bool "music"
        config EXAMPLE_MODE_ECHO
            bool "echo"
    endchoice

    choice EXAMPLE_SELECT_MIC_GAIN
        prompt "Set MIC gain"
        depends on EXAMPLE_MODE_ECHO
        default MIC_GAIN_18DB
        help
            Select mic gain for echo mode

        config MIC_GAIN_0DB
            bool "0dB"
        config MIC_GAIN_6DB
            bool "6dB"
        config MIC_GAIN_12DB
            bool "12dB"
        config MIC_GAIN_18DB
            bool "18dB"
        config MIC_GAIN_24DB
            bool "24dB"
        config MIC_GAIN_30DB
            bool "30dB"
        config MIC_GAIN_36DB
            bool "36dB"
        config MIC_GAIN_42DB
            bool "42dB"
    endchoice

    config EXAMPLE_MIC_GAIN
        int
        default 0 if MIC_GAIN_0DB
        default 6 if MIC_GAIN_6DB
        default 12 if MIC_GAIN_12DB
        default 18 if MIC_GAIN_18DB
        default 24 if MIC_GAIN_24DB
        default 30 if MIC_GAIN_30DB
        default 36 if MIC_GAIN_36DB
        default 42 if MIC_GAIN_42DB

    config EXAMPLE_VOICE_VOLUME
        int "Voice volume"
        range 0 100
        default 60
        help
            Set voice volume

endmenu
```

## components/odroid/Kconfig.projbuild
```kconfig
menu "RetroESP32 Platform"

    config HDMI_OUTPUT
        bool "Use HDMI output (LT8912) instead of LCD (ST7701)"
        default n
        help
            When enabled, the display pipeline outputs to an HDMI monitor
            via the LT8912 MIPI-to-HDMI bridge at 640x480 RGB888.
            When disabled (default), the display outputs to the ST7701
            480x800 MIPI DSI LCD panel.

    config BOARD_WAVESHARE_P4_43
        bool "Waveshare ESP32-P4-WIFI6-Touch-LCD-4.3 (instead of Guition 4.3-inch LCD)"
        default n
        depends on !HDMI_OUTPUT
        help
            Select the Waveshare ESP32-P4-WIFI6-Touch-LCD-4.3 pin map and
            panel configuration for the handheld (LCD) build.  Changes the
            LCD reset / backlight pins and polarity, ST7701 init sequence and
            DPI timing, audio PA / I2S pins, battery ADC and the GPIO-pad X
            button.  When disabled (default) the Guition 4.3-inch board is used.
            Rev3.x ESP32-P4 silicon additionally needs sdkconfig.p4rev3.defaults.

    config LT8912_I2C_SDA
        int "LT8912 I2C SDA GPIO"
        default 7
        depends on HDMI_OUTPUT

    config LT8912_I2C_SCL
        int "LT8912 I2C SCL GPIO"
        default 8
        depends on HDMI_OUTPUT

    config LT8912_RESET_GPIO
        int "LT8912 Reset GPIO"
        default 23
        depends on HDMI_OUTPUT

endmenu
```
